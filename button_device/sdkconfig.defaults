## button_device/sdkconfig.defaults
```kconfig
# Target
CONFIG_IDF_TARGET="esp32c6"

# Partition Table
CONFIG_PARTITION_TABLE_CUSTOM=y
CONFIG_PARTITION_TABLE_CUSTOM_FILENAME="partitions.csv"
CONFIG_PARTITION_TABLE_FILENAME="partitions.csv"

# Bluetooth (NimBLE) for Commissioning
CONFIG_BT_ENABLED=y
CONFIG_BT_NIMBLE_ENABLED=y
CONFIG_BT_NIMBLE_MAX_CONNECTIONS=1

# OpenThread and 802.15.4 Radio
CONFIG_IEEE802154_ENABLED=y
CONFIG_OPENTHREAD_ENABLED=y
CONFIG_OPENTHREAD_RADIO_NATIVE=y
CONFIG_OPENTHREAD_DEVICE_TYPE_SED=y

# Disable Wi-Fi to prioritize Thread and save power
CONFIG_ENABLE_WIFI_STATION=n
CONFIG_ENABLE_WIFI_AP=n

# LwIP IPv6
CONFIG_LWIP_IPV6=y
CONFIG_LWIP_IPV6_AUTOCONFIG=y
CONFIG_LWIP_IPV6_DHCP6=y

# ESP Matter Core and ICD (Sleepy) Configurations
CONFIG_ESP_MATTER_ENABLE=y
CONFIG_ESP_MATTER_ENABLE_ICD_SUPPORT=y

# Power Management (Crucial for Sleepy End Device battery life)
CONFIG_PM_ENABLE=y
CONFIG_FREERTOS_USE_TICKLESS_IDLE=y
CONFIG_PM_DFS_INIT_MIN_FREQ_MHZ=10
CONFIG_PM_DFS_INIT_MAX_FREQ_MHZ=80

# Logging
CONFIG_LOG_DEFAULT_LEVEL_INFO=y
```

## generic_switch/main/Kconfig.projbuild
```kconfig
 menu "Demo"
    choice GENERIC_SWITCH_TYPE
	  prompt "Generic Switch Type"
	  default GENERIC_SWITCH_TYPE_MOMENTARY
	  help
	      Define type of switch is latching or momentary.

	  config GENERIC_SWITCH_TYPE_LATCHING
	      bool "Generic Switch Type Latching"
	  config GENERIC_SWITCH_TYPE_MOMENTARY
	      bool "Generic Switch Type Momentary"
	endchoice
    config MAX_CONFIGURABLE_BUTTONS
        int "Maximum physical configurable buttons"
        default 5
        range 1 5
endmenu

menu "Board Configuration"
    config BOARD_LED_PIN
        int "Status LED Pin"
        default 15
        help
            The GPIO pin for the status LED.

    config BOARD_LED_TYPE_WS2812
        bool "Addressable RGB (WS2812)"
        default n
        help
            Select this if your board uses an addressable WS2812 for the status LED.

    config BOARD_BUTTON_PIN
        int "Physical Button Pin"
        default 9
        help
            The GPIO pin for the physical button.

    config BOARD_MATTER_DISCRIMINATOR
        int "Matter Setup Discriminator"
        default 3842
        help
            The 12-bit Matter setup discriminator (0-4095) used for pairing. 
            Change this if you are deploying multiple devices to avoid conflicts.
endmenu
```

## generic_switch/sdkconfig.defaults
```kconfig
# CONFIG_IDF_TARGET="esp32c6"

CONFIG_ESPTOOLPY_FLASHSIZE_4MB=y

#enable BT
CONFIG_BT_ENABLED=y
CONFIG_BT_NIMBLE_ENABLED=y

#disable BT connection reattempt
CONFIG_BT_NIMBLE_ENABLE_CONN_REATTEMPT=n

#enable lwip ipv6 autoconfig
CONFIG_LWIP_IPV6_AUTOCONFIG=y

# Use a custom partition table
CONFIG_PARTITION_TABLE_CUSTOM=y
CONFIG_PARTITION_TABLE_FILENAME="partitions.csv"

# Enable chip shell
CONFIG_ENABLE_CHIP_SHELL=y

CONFIG_ENABLE_WIFI_AP=n

# This example uses 3 dynamic endpoints (root node + button state + LED indicator)
CONFIG_ESP_MATTER_MAX_DYNAMIC_ENDPOINT_COUNT=3

#enable lwIP route hooks
CONFIG_LWIP_HOOK_IP6_ROUTE_DEFAULT=y
CONFIG_LWIP_HOOK_ND6_GET_GW_DEFAULT=y

# Button
CONFIG_BUTTON_PERIOD_TIME_MS=20
CONFIG_BUTTON_LONG_PRESS_TIME_MS=1500

# disable softap by default
CONFIG_ESP_WIFI_SOFTAP_SUPPORT=n

# Enable OTA Requestor
CONFIG_ENABLE_OTA_REQUESTOR=y

# Enable HKDF in mbedtls
CONFIG_MBEDTLS_HKDF_C=y

# Increase LwIP IPv6 address number to 6 (MAX_FABRIC + 1)
# unique local addresses for fabrics(MAX_FABRIC), a link local address(1)
CONFIG_LWIP_IPV6_NUM_ADDRESSES=6

# disable groupcast cluster until verified
CONFIG_SUPPORT_GROUPCAST_CLUSTER=n

# enable USB serial JTAG
# CONFIG_ESP_CONSOLE_USB_SERIAL_JTAG=y

# Tell the chip to look at the factory partition for the discriminator
#CONFIG_ENABLE_ESP32_FACTORY_DATA_PROVIDER=y
#CONFIG_ENABLE_ESP32_DEVICE_INFO_PROVIDER=y
```

## led_device/sdkconfig.defaults
```kconfig
# Target
CONFIG_IDF_TARGET="esp32c6"

# Partition Table
CONFIG_PARTITION_TABLE_CUSTOM=y
CONFIG_PARTITION_TABLE_CUSTOM_FILENAME="partitions.csv"
CONFIG_PARTITION_TABLE_FILENAME="partitions.csv"

# Bluetooth (NimBLE) for Commissioning
CONFIG_BT_ENABLED=y
CONFIG_BT_NIMBLE_ENABLED=y
CONFIG_BT_NIMBLE_MAX_CONNECTIONS=1

# OpenThread and 802.15.4 Radio
CONFIG_IEEE802154_ENABLED=y
CONFIG_OPENTHREAD_ENABLED=y
CONFIG_OPENTHREAD_RADIO_NATIVE=y
CONFIG_OPENTHREAD_DEVICE_TYPE_FTD=y

# Disable Wi-Fi to prioritize Thread
CONFIG_ENABLE_WIFI_STATION=n
CONFIG_ENABLE_WIFI_AP=n

# LwIP IPv6
CONFIG_LWIP_IPV6=y
CONFIG_LWIP_IPV6_AUTOCONFIG=y
CONFIG_LWIP_IPV6_DHCP6=y

# ESP Matter Core
CONFIG_ESP_MATTER_ENABLE=y

# No Sleep/Power Management (Mains powered, needs to keep radio ON and route packets)
CONFIG_PM_ENABLE=n

# Logging
CONFIG_LOG_DEFAULT_LEVEL_INFO=y
```

## light/main/Kconfig.projbuild
```kconfig
menu "Example Configuration"

    config ENABLE_MEMORY_PROFILING
        bool "Enable Memory Profiling"
        default n
        help
            Enable this option to include memory profiling features in the example.
            This will allow you to monitor memory usage during runtime.

endmenu

menu "Board Configuration"
    config BOARD_LED_PIN
        int "Status LED Pin"
        default 15
        help
            The GPIO pin for the status LED.

    config BOARD_LED_TYPE_WS2812
        bool "Addressable RGB (WS2812)"
        default n
        help
            Select this if your board uses an addressable WS2812 for the status LED.

    config BOARD_BUTTON_PIN
        int "Physical Button Pin"
        default 9
        help
            The GPIO pin for the physical button.

    config BOARD_MATTER_DISCRIMINATOR
        int "Matter Setup Discriminator"
        default 3841
        help
            The 12-bit Matter setup discriminator (0-4095) used for pairing. 
            Change this if you are deploying multiple devices to avoid conflicts.
endmenu
```
